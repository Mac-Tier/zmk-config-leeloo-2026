#include <dt-bindings/zmk/matrix_transform.h>

/ {
    chosen {
        zmk,physical-layout = &physical_layout0;
    };

    physical_layout0: physical_layout_0 {
        compatible = "zmk,physical-layout";
        display-name = "Leeloo Rev 3 Layout";
        transform = <&default_transform>;
        keys = <&keys>;
    };
};
